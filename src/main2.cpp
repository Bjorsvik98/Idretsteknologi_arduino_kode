#include <Arduino.h>
#include <FastLED.h>
#include <interrupt_func.h>
#include <fast_LED.h>
#include <Button.h>
#include <button_lib.h>
// #include <pgmspace.h>


#define NUM_LEDS 20
#define LED_pin 3
#define button1 2
#define button2 4

unsigned long StartTime = 0;
unsigned long time2 = 0;
unsigned long time1 = 0;
unsigned long timeStart = 0;
const int buzzer = 9; //buzzer to arduino pin 9
Button button3(4);


int array2[] = {50, 50, 50, 50, 50, 50, 200, 200, 200, 200, 50, 50, 50, 50, 50, 50, 200, 200, 200, 200};
int j = 0; 
// int long_array[] = {32, 33, 35, 33, 33, 31, 31, 33, 34, 31, 31, 29, 31,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 34, 34};
int k = 0;
// int array2[] = {10,10,10,10,10,10,10,10,10,10,10,10,10,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300,300};
// int array3[] = {10,10,10,10,10,10,10,10,10,10,10,10,10,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100,100};






void setup() {
  Serial.begin(9600);
  fast_LED_init();
  // interrupt_init();
  // button_init();
  Serial.println("Program starts");
  button3.begin();

  StartTime = millis();

  pinMode(button1, INPUT);
  pinMode(button2, INPUT);

  pinMode(LED_pin, OUTPUT);
  pinMode(buzzer, OUTPUT); // Set buzzer - pin 9 as an output






}

void loop() {
  // run_strip();
  // change_speed();
  // strip_blink_const_speed();

  // run_one_light(0, CRGB::White);
  j = 0;
  if (true){
  // if (button3.pressed()){
    
    time1 = millis();
    
    if (digitalRead(button1)){
      time2 = millis();

      while(millis()-time2 < 4500){
        if (millis()-time2 < 500){
          digitalWrite(LED_pin, HIGH);
          tone(buzzer, 700);
        } else if (millis()-time2 < 1000) {
          digitalWrite(LED_pin, LOW);
          noTone(buzzer);
        } else if (millis()-time2 < 1500){
          digitalWrite(LED_pin, HIGH);
          tone(buzzer, 700);
        } else if (millis()-time2 < 2000) {
          digitalWrite(LED_pin, LOW);
          noTone(buzzer);
        } else if (millis()-time2 < 2500){
          digitalWrite(LED_pin, HIGH);
          tone(buzzer, 700);
        } else if (millis()-time2 < 3000) {
          digitalWrite(LED_pin, LOW);
          noTone(buzzer);
        } else if (millis()-time2 < 3500){
          digitalWrite(LED_pin, HIGH);
          tone(buzzer, 2000);
        } else if (millis()-time2 < 4400) {
          digitalWrite(LED_pin, LOW);
          noTone(buzzer);
        }
      }
      timeStart = millis();

    
    while(j < NUM_LEDS){
          
      if (millis() > (time1 + array2[k])){
        time1 = millis();
        
        
        clead_one_light(j-1);
        run_one_light(j, CRGB::Green);
        j++;
        k++;
        

      }
      int size = sizeof(array2) / sizeof(int);
      if (k == size){
        k = 0;
      }
     
      
    }
    clead_one_light(NUM_LEDS-1);
      while (digitalRead(button2) == false){

      }
      Serial.println(millis() - timeStart);
      tone(buzzer, 2000);
      timeStart = millis();
      while ((millis()-timeStart < 1000)){

      }
      noTone(buzzer);

    }
    
  }
  

  


  
  


  
  // unsigned long CurrentTime = millis();
  // unsigned long ElapsedTime = CurrentTime - StartTime;



}

